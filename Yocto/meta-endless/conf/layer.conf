## Yocto/meta-endless/conf/layer.conf
```bitbake
# We have a conf and classes directory, add to BBPATH
BBPATH .= ":${LAYERDIR}"

# We have recipes-* directories, add to BBFILES
BBFILES += "${LAYERDIR}/recipes-*/*/*.bb \
            ${LAYERDIR}/recipes-*/*/*.bbappend"
BBFILES += "${LAYERDIR}/recipes-*/*/*/*.bb \
            ${LAYERDIR}/recipes-*/*/*/*.bbappend"

BBFILE_COLLECTIONS += "meta-endless"
BBFILE_PATTERN_meta-endless = "^${LAYERDIR}/"
BBFILE_PRIORITY_meta-endless = "6"

LAYERDEPENDS_meta-endless = "core"
LAYERSERIES_COMPAT_meta-endless = "styhead walnascar"
```

## Yocto/raspberry3-build/conf/bblayers.conf
```bitbake
# POKY_BBLAYERS_CONF_VERSION is increased each time build/conf/bblayers.conf
# changes incompatibly
POKY_BBLAYERS_CONF_VERSION = "2"

BBPATH = "${TOPDIR}"
BBFILES ?= ""

BBLAYERS ?= " \
  /home/jfasch/My-Projects/yocto/poky/meta \
  /home/jfasch/My-Projects/yocto/poky/meta-poky \
  /home/jfasch/My-Projects/yocto/poky/meta-yocto-bsp \
  "

BBLAYERS += " /home/jfasch/My-Projects/yocto/meta-raspberrypi"
```
